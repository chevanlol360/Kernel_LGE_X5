/* Copyright (c) 2013, LGE Electronics. All rights reserved.
 *
 * This program is free software; you can redistribute it and/or modify
 * it under the terms of the GNU General Public License version 2 and
 * only version 2 as published by the Free Software Foundation.
 *
 * This program is distributed in the hope that it will be useful,
 * but WITHOUT ANY WARRANTY; without even the implied warranty of
 * MERCHANTABILITY or FITNESS FOR A PARTICULAR PURPOSE.  See the
 * GNU General Public License for more details.
 */

&soc {
	i2c@f9927000 { /* BLSP1 QUP5 */
		atmel_s336@4a {
			compatible = "atmel,s336";
			revision = "rev_0...";
			status = "ok";
			reg = <0x4a>;
			atmel,fw_name = "atmel/Jaguar01.fw";
			atmel,ghost_detection_enable = <1>;
			interrupt-parent = <&msmgpio>;
			interrupts = <17 0x0>;
			atmel,reset-gpio = <&msmgpio 16 0x00>;
			atmel,irq-gpio = <&msmgpio 17 0x00>;
			atmel,lcd_x = <720>;
			atmel,lcd_y = <1280>;
		};

		lge_ts_misc {
			revision = "rev_0...";
			vdd_on = <1>;
			vio_l19_on = <1>;
			vio_lvs1_on = <1>;
			irq_wake = <0>;
			status ="ok";
		};
	};
};
