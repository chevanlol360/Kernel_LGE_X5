/* Copyright (c) 2013, LGE Electronics. All rights reserved.
 *
 * This program is free software; you can redistribute it and/or modify
 * it under the terms of the GNU General Public License version 2 and
 * only version 2 as published by the Free Software Foundation.
 *
 * This program is distributed in the hope that it will be useful,
 * but WITHOUT ANY WARRANTY; without even the implied warranty of
 * MERCHANTABILITY or FITNESS FOR A PARTICULAR PURPOSE.  See the
 * GNU General Public License for more details.
 */

&soc {
	i2c@f9927000 { /* BLSP1 QUP5 */
		atmel_s336@4a {
			revision = "rev_0...";
			status = "ok";
			atmel,fw_name = "atmel/Jaguar02.fw";
			atmel,panel_check = <0>;
			atmel,reset-gpio = <&msmgpio 16 0x00>;
		};

		lge_ts_misc {
			revision = "rev_c...";
			vdd_on = <1>;
			vio_l19_on = <1>;
			vio_lvs1_on = <1>;
			irq_wake = <0>;
			status ="ok";
		};
	};

};
